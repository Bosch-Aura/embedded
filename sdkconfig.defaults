## sdkconfig.defaults
```kconfig
# FreeRTOS Configuration
CONFIG_FREERTOS_HZ=1000
CONFIG_FREERTOS_UNICORE=n

# UART Configuration
CONFIG_UART1_BAUD_RATE=921600

# Logging
CONFIG_LOG_DEFAULT_LEVEL_INFO=y
CONFIG_LOG_MAXIMUM_LEVEL_VERBOSE=y

# ESP32 CPU Frequency
CONFIG_ESP32_DEFAULT_CPU_FREQ_240=y

# Task Watchdog (optional, but recommended)
CONFIG_ESP_TASK_WDT=y
CONFIG_ESP_TASK_WDT_TIMEOUT_S=10
```
